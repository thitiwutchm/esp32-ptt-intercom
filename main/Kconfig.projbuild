## main/Kconfig.projbuild
```kconfig
menu "PTT Intercom"

    choice PTT_BOARD
        prompt "Board"
        default PTT_BOARD_ECHOEAR
        help
            Pin maps follow the xiaozhi-esp32 board definitions
            (boards/espressif/esp-vocat and boards/nologo/xingzhi-cube-1.54tft-wifi).

        config PTT_BOARD_ECHOEAR
            bool "EchoEar / ESP-VoCat (1.85\" round 360x360 ST77916 + CST816, ES8311 + ES7210)"
        config PTT_BOARD_CUBE
            bool "Xingzhi CUBE 1.54\" TFT Wi-Fi (240x240 ST7789, I2S mic + I2S amp)"
    endchoice

    config PTT_WIFI_SSID
        string "Wi-Fi SSID (2.4 GHz), empty = set up from a phone"
        default ""
        help
            Leave empty to configure Wi-Fi and SIP from a phone: the device
            opens a setup network and shows a QR code. Settings saved from
            the phone replace everything here. Hold BOOT for 8 s to open
            phone setup again.

    config PTT_WIFI_PASSWORD
        string "Wi-Fi password"
        default ""

    config PTT_UDP_PORT
        int "UDP port"
        range 1024 65535
        default 47000
        help
            Every device on the LAN must use the same port.

    config PTT_DEFAULT_CHANNEL
        int "Channel on first boot"
        range 1 16
        default 1

    config PTT_DEFAULT_VOLUME
        int "Speaker volume on first boot (0-100)"
        range 0 100
        default 70

    choice PTT_CODEC
        prompt "Voice codec for sending"
        default PTT_CODEC_ADPCM
        help
            Receivers decode both, so devices with different settings still talk.

        config PTT_CODEC_ADPCM
            bool "IMA ADPCM, 64 kbit/s"
        config PTT_CODEC_PCM16
            bool "PCM 16-bit, 256 kbit/s"
    endchoice

    config PTT_JITTER_FRAMES
        int "Jitter buffer prefill (20 ms frames)"
        range 1 10
        default 3
        help
            Frames queued before playback starts. 3 = 60 ms. Raise it if
            audio stutters on a busy network.

    config PTT_MIC_GAIN_DB
        int "Microphone gain in dB (EchoEar ES7210)"
        range 0 37
        default 30
        depends on PTT_BOARD_ECHOEAR

    config PTT_MIC_SHIFT
        int "Microphone 32->16 bit right shift (CUBE I2S mic)"
        range 8 16
        default 12
        depends on PTT_BOARD_CUBE
        help
            Smaller shifts mean more gain. 16 is the raw 24-bit mic level.

    menu "SIP intercom (Asterisk / Home Assistant), defaults for phone setup"

        config PTT_SIP_ENABLE
            bool "Register to a SIP PBX for calls"
            default y
            help
                The device becomes an extension of the PBX: it can be called
                (for example from a Home Assistant dashboard through SIP Core)
                and BOOT calls PTT_SIP_CALL_TARGET. Calls are full duplex
                with echo cancellation.

        config PTT_SIP_SERVER
            string "PBX address (IPv4 recommended)"
            default "192.168.1.10"
            depends on PTT_SIP_ENABLE
            help
                Address of Asterisk, e.g. the Home Assistant host running the
                Asterisk add-on. Host names need DNS; ".local" names do not
                resolve.

        config PTT_SIP_PORT
            int "PBX SIP port (UDP)"
            default 5060
            depends on PTT_SIP_ENABLE

        config PTT_SIP_USER
            string "Extension / user name"
            default "200"
            depends on PTT_SIP_ENABLE

        config PTT_SIP_PASSWORD
            string "Password"
            default ""
            depends on PTT_SIP_ENABLE

        config PTT_SIP_DISPLAY
            string "Caller name shown to others"
            default "Desk"
            depends on PTT_SIP_ENABLE

        config PTT_SIP_CALL_TARGET
            string "Number BOOT calls (e.g. the Home Assistant extension or a ring group)"
            default "100"
            depends on PTT_SIP_ENABLE

        config PTT_SIP_AUTO_ANSWER
            bool "Answer at once when the PBX asks for it (Call-Info answer-after)"
            default n
            depends on PTT_SIP_ENABLE
            help
                Off: every call rings and is answered with a press. On: calls
                that carry the auto-answer header open the line immediately,
                like a classic intercom.

        config PTT_SIP_LOCAL_PORT
            int "Local SIP port"
            default 5060
            depends on PTT_SIP_ENABLE

        config PTT_SIP_RTP_PORT
            int "Local RTP port"
            default 40000
            depends on PTT_SIP_ENABLE

        choice PTT_ECHO
            prompt "Echo handling during calls"
            default PTT_ECHO_AEC
            depends on PTT_SIP_ENABLE

            config PTT_ECHO_AEC
                bool "Acoustic echo cancellation (ESP-SR), full duplex"
                help
                    EchoEar uses the ES7210 hardware reference. Boards without
                    one (CUBE) use the played audio as a software reference,
                    aligned by a chirp at the start of every call; if that
                    measurement fails the call falls back to ducking.
            config PTT_ECHO_DUCK
                bool "Ducking: lower the mic while the far end talks"
            config PTT_ECHO_NONE
                bool "None"
        endchoice

    endmenu

endmenu
```
